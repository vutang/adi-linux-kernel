// SPDX-License-Identifier: GPL-2.0
/*
 * Analog Devices LTC2387 in TWO LANES mode
 *
 * hdl_project: <cn0577/zed> with make TWOLANES=1
 * board_revision: <A>
 *
 * Copyright (C) 2023 Analog Devices Inc.
 */

#include "zynq-zed-adv7511-cn0577.dts"


&ltc2387_0 {
	// enable TWOLANES mode (parameter TWOLANES=1)
	/delete-property/ adi,use-one-lane;
	adi,use-two-lanes;
};
